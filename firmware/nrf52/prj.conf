## CMakeLists.txt
```
cmake_minimum_required(VERSION 3.20.0)
find_package(Zephyr REQUIRED HINTS $ENV{ZEPHYR_BASE})
project(voice_brooch_nrf52)

target_sources(app PRIVATE
    src/main.c
    src/board_nrf52.c
    src/ble_gatt.c
    ../shared/vb_protocol.c
    ../shared/vb_button.c
    ../shared/vb_app.c
)

target_include_directories(app PRIVATE
    src
    ../shared
)
```

## prj.conf
```kconfig
CONFIG_MAIN_STACK_SIZE=4096
CONFIG_SYSTEM_WORKQUEUE_STACK_SIZE=2048

CONFIG_GPIO=y
CONFIG_ADC=y
CONFIG_INPUT=y
CONFIG_REGULATOR=y

CONFIG_BT=y
CONFIG_BT_PERIPHERAL=y
CONFIG_BT_DEVICE_NAME="VoiceBrooch"
CONFIG_BT_MAX_CONN=1
CONFIG_BT_GATT_DYNAMIC_DB=y
CONFIG_BT_ATT_PREPARE_COUNT=2

CONFIG_SERIAL=n
CONFIG_CONSOLE=n
CONFIG_UART_CONSOLE=n
```

## src/main.c
```c
#include "board_nrf52.h"
#include "ble_gatt.h"
#include "vb_app.h"

#include <zephyr/kernel.h>

static vb_app_t s_app;

int main(void)
{
    board_nrf52_init();

    vb_ble_ops_t ble_ops = {
        .ble_notify_status = ble_gatt_notify_status,
        .ble_notify_event = ble_gatt_notify_event,
        .ble_ctx = NULL
    };
    vb_app_init(&s_app, board_nrf52_ops(), &ble_ops);

    if (ble_gatt_init(&s_app) != 0) {
        return -1;
    }

    while (1) {
        vb_app_tick(&s_app);
        k_sleep(K_MSEC(10));
    }

    return 0;
}
```

## src/ble_gatt.c
```c
#include "ble_gatt.h"
#include "vb_protocol.h"

#include <zephyr/bluetooth/bluetooth.h>
#include <zephyr/bluetooth/gatt.h>
#include <zephyr/bluetooth/hci.h>
#include <zephyr/bluetooth/uuid.h>
#include <zephyr/kernel.h>
#include <string.h>

static vb_app_t *s_app;
static bool s_connected;
static struct bt_conn *s_conn;

static struct bt_uuid_128 uuid_svc = BT_UUID_INIT_128(
    0xfb, 0x34, 0xd5, 0xf9, 0x05, 0x80, 0x00, 0x80,
    0x00, 0x10, 0x00, 0x00, 0x01, 0xc0, 0xb2, 0xa1);
static struct bt_uuid_128 uuid_control = BT_UUID_INIT_128(
    0xfb, 0x34, 0xd5, 0xf9, 0x05, 0x80, 0x00, 0x80,
    0x00, 0x10, 0x00, 0x00, 0x02, 0xc0, 0xb2, 0xa1);
static struct bt_uuid_128 uuid_status = BT_UUID_INIT_128(
    0xfb, 0x34, 0xd5, 0xf9, 0x05, 0x80, 0x00, 0x80,
    0x00, 0x10, 0x00, 0x00, 0x03, 0xc0, 0xb2, 0xa1);
static struct bt_uuid_128 uuid_event = BT_UUID_INIT_128(
    0xfb, 0x34, 0xd5, 0xf9, 0x05, 0x80, 0x00, 0x80,
    0x00, 0x10, 0x00, 0x00, 0x04, 0xc0, 0xb2, 0xa1);
static struct bt_uuid_128 uuid_info = BT_UUID_INIT_128(
    0xfb, 0x34, 0xd5, 0xf9, 0x05, 0x80, 0x00, 0x80,
    0x00, 0x10, 0x00, 0x00, 0x05, 0xc0, 0xb2, 0xa1);

static uint8_t status_ccc_cfg_changed;
static uint8_t event_ccc_cfg_changed;
static char s_device_name[24] = "VoiceBrooch-0000";

/* vb_svc.attrs 索引：0=svc, 1=control decl, 2=control val,
   3=status decl, 4=status val, 5=status ccc, 6=event decl, 7=event val, 8=event ccc,
   9=info decl, 10=info val */
#define STATUS_ATTR_INDEX 4
#define EVENT_ATTR_INDEX  7

static ssize_t on_control_write(struct bt_conn *conn, const struct bt_gatt_attr *attr,
                                const void *buf, uint16_t len, uint16_t offset, uint8_t flags)
{
    ARG_UNUSED(conn);
    ARG_UNUSED(attr);
    ARG_UNUSED(offset);
    ARG_UNUSED(flags);

    if (s_app != NULL) {
        vb_app_on_control_write(s_app, buf, len);
    }
    return len;
}

static ssize_t on_status_read(struct bt_conn *conn, const struct bt_gatt_attr *attr,
                              void *buf, uint16_t len, uint16_t offset)
{
    ARG_UNUSED(conn);
    ARG_UNUSED(attr);

    if (s_app == NULL) {
        return BT_GATT_ERR(BT_ATT_ERR_UNLIKELY);
    }

    uint8_t pl[6];
    size_t plen = vb_build_status_payload(vb_app_state(s_app), pl, sizeof(pl));
    uint8_t frame[16];
    size_t fn = vb_encode_frame(VB_EVT_STATUS, pl, (uint8_t)plen, frame, sizeof(frame));
    return bt_gatt_attr_read(conn, attr, buf, len, offset, frame, fn);
}

static ssize_t on_info_read(struct bt_conn *conn, const struct bt_gatt_attr *attr,
                            void *buf, uint16_t len, uint16_t offset)
{
    ARG_UNUSED(conn);
    ARG_UNUSED(attr);
    static const char info[] = "VoiceBrooch-nRF52-v1.0.0";
    return bt_gatt_attr_read(conn, attr, buf, len, offset, info, sizeof(info) - 1);
}

BT_GATT_SERVICE_DEFINE(vb_svc,
    BT_GATT_PRIMARY_SERVICE(&uuid_svc),
    BT_GATT_CHARACTERISTIC(&uuid_control.uuid,
                           BT_GATT_CHRC_WRITE | BT_GATT_CHRC_WRITE_WITHOUT_RESP,
                           BT_GATT_PERM_WRITE,
                           NULL, on_control_write, NULL),
    BT_GATT_CHARACTERISTIC(&uuid_status.uuid,
                           BT_GATT_CHRC_READ | BT_GATT_CHRC_NOTIFY,
                           BT_GATT_PERM_READ,
                           on_status_read, NULL, NULL),
    BT_GATT_CCC(&status_ccc_cfg_changed, BT_GATT_PERM_READ | BT_GATT_PERM_WRITE),
    BT_GATT_CHARACTERISTIC(&uuid_event.uuid,
                           BT_GATT_CHRC_NOTIFY,
                           BT_GATT_PERM_NONE,
                           NULL, NULL, NULL),
    BT_GATT_CCC(&event_ccc_cfg_changed, BT_GATT_PERM_READ | BT_GATT_PERM_WRITE),
    BT_GATT_CHARACTERISTIC(&uuid_info.uuid,
                           BT_GATT_CHRC_READ,
                           BT_GATT_PERM_READ,
                           on_info_read, NULL, NULL)
);

static int notify_frame(uint8_t attr_index, uint8_t evt_cmd,
                        const uint8_t *payload, uint8_t payload_len)
{
    if (!s_connected || s_conn == NULL) {
        return 0;
    }

    uint8_t frame[6 + VB_MAX_PAYLOAD];
    size_t n = vb_encode_frame(evt_cmd, payload, payload_len, frame, sizeof(frame));
    if (n == 0) {
        return -EINVAL;
    }

    return bt_gatt_notify(s_conn, &vb_svc.attrs[attr_index], frame, n);
}

void ble_gatt_notify_status(uint8_t evt_cmd, const uint8_t *payload, uint8_t len, void *ctx)
{
    ARG_UNUSED(ctx);
    notify_frame(STATUS_ATTR_INDEX, evt_cmd, payload, len);
}

void ble_gatt_notify_event(uint8_t evt_cmd, const uint8_t *payload, uint8_t len, void *ctx)
{
    ARG_UNUSED(ctx);
    notify_frame(EVENT_ATTR_INDEX, evt_cmd, payload, len);
}

static void connected(struct bt_conn *conn, uint8_t err)
{
    if (err) {
        return;
    }
    s_conn = bt_conn_ref(conn);
    s_connected = true;
    if (s_app) {
        vb_app_set_connected(s_app, true);
    }
}

static void disconnected(struct bt_conn *conn, uint8_t reason)
{
    ARG_UNUSED(reason);
    if (s_conn) {
        bt_conn_unref(s_conn);
        s_conn = NULL;
    }
    s_connected = false;
    if (s_app) {
        vb_app_set_connected(s_app, false);
    }
}

BT_CONN_CB_DEFINE(conn_cb) = {
    .connected = connected,
    .disconnected = disconnected,
};

static void set_adv_name(void)
{
    bt_addr_le_t addrs[1];
    size_t count = 1;

    bt_id_get(addrs, &count);
    snprintk(s_device_name, sizeof(s_device_name), "VoiceBrooch-%02X%02X",
             addrs[0].a.val[4], addrs[0].a.val[5]);
    bt_set_name(s_device_name);
}

static const struct bt_data ad[] = {
    BT_DATA_BYTES(BT_DATA_FLAGS, (BT_LE_AD_GENERAL | BT_LE_AD_NO_BREDR)),
    BT_DATA(BT_DATA_UUID128_ALL, uuid_svc.val, sizeof(uuid_svc.val)),
};

static struct bt_data sd;

static void advertise(void)
{
    sd = (struct bt_data)BT_DATA(BT_DATA_NAME_COMPLETE,
                                 s_device_name,
                                 strlen(s_device_name));
    bt_le_adv_start(BT_LE_ADV_CONN, ad, ARRAY_SIZE(ad), &sd, 1);
}

int ble_gatt_init(vb_app_t *app)
{
    s_app = app;
    int err = bt_enable(NULL);
    if (err) {
        return err;
    }
    set_adv_name();
    advertise();
    return 0;
}
```

## src/ble_gatt.h
```c
#ifndef BLE_GATT_NRF_H
#define BLE_GATT_NRF_H

#include "vb_app.h"
#include <stddef.h>
#include <stdint.h>

int ble_gatt_init(vb_app_t *app);
void ble_gatt_notify_status(uint8_t evt_cmd, const uint8_t *payload, uint8_t len, void *ctx);
void ble_gatt_notify_event(uint8_t evt_cmd, const uint8_t *payload, uint8_t len, void *ctx);

#endif
```

## src/board_nrf52.c
```c
#include "board_nrf52.h"

#include <zephyr/device.h>
#include <zephyr/devicetree.h>
#include <zephyr/drivers/adc.h>
#include <zephyr/drivers/gpio.h>
#include <zephyr/kernel.h>

#if DT_NODE_HAS_STATUS(DT_ALIAS(sw0), okay)

static const struct gpio_dt_spec s_button = GPIO_DT_SPEC_GET(DT_ALIAS(sw0), gpios);
static const struct gpio_dt_spec s_led = GPIO_DT_SPEC_GET(DT_ALIAS(led0), gpios);
static const struct gpio_dt_spec s_charge = GPIO_DT_SPEC_GET(DT_ALIAS(charge0), gpios);
static const struct adc_dt_spec s_mic_adc = ADC_DT_SPEC_GET_BY_IDX(DT_PATH(zephyr_user), 0);
static const struct adc_dt_spec s_batt_adc = ADC_DT_SPEC_GET_BY_IDX(DT_PATH(zephyr_user), 1);
static int16_t s_adc_buf;

#else /* DK fallback pins — apply voice_brooch.overlay for PCB */

#define PIN_BUTTON  11
#define PIN_LED     13
#define PIN_CHARGE  12

static const struct device *s_gpio0;
static const struct device *s_adc_dev;
static struct adc_channel_cfg s_mic_cfg;
static struct adc_channel_cfg s_batt_cfg;
static int16_t s_adc_buf;

#endif

void board_nrf52_init(void)
{
#if DT_NODE_HAS_STATUS(DT_ALIAS(sw0), okay)
    if (!gpio_is_ready_dt(&s_button) || !gpio_is_ready_dt(&s_led) ||
        !gpio_is_ready_dt(&s_charge)) {
        return;
    }
    gpio_pin_configure_dt(&s_button, GPIO_INPUT);
    gpio_pin_configure_dt(&s_led, GPIO_OUTPUT_INACTIVE);
    gpio_pin_configure_dt(&s_charge, GPIO_INPUT);
    if (adc_is_ready_dt(&s_mic_adc)) {
        adc_channel_setup_dt(&s_mic_adc);
    }
    if (adc_is_ready_dt(&s_batt_adc)) {
        adc_channel_setup_dt(&s_batt_adc);
    }
#else
    s_gpio0 = DEVICE_DT_GET(DT_NODELABEL(gpio0));
    s_adc_dev = DEVICE_DT_GET(DT_NODELABEL(adc));
    gpio_pin_configure(s_gpio0, PIN_LED, GPIO_OUTPUT_INACTIVE | GPIO_ACTIVE_HIGH);
    gpio_pin_configure(s_gpio0, PIN_BUTTON, GPIO_INPUT | GPIO_PULL_UP);
    gpio_pin_configure(s_gpio0, PIN_CHARGE, GPIO_INPUT | GPIO_PULL_UP);
    s_mic_cfg = (struct adc_channel_cfg){
        .gain = ADC_GAIN_1_6,
        .reference = ADC_REF_INTERNAL,
        .acquisition_time = ADC_ACQ_TIME_DEFAULT,
        .channel_id = 1,
        .input_positive = SAADC_CH_PSELP_PSELP_AnalogInput1
    };
    s_batt_cfg = s_mic_cfg;
    s_batt_cfg.channel_id = 2;
    s_batt_cfg.input_positive = SAADC_CH_PSELP_PSELP_AnalogInput2;
    adc_channel_setup(s_adc_dev, &s_mic_cfg);
    adc_channel_setup(s_adc_dev, &s_batt_cfg);
#endif
}

#if DT_NODE_HAS_STATUS(DT_ALIAS(sw0), okay)

static uint16_t read_adc_dt(const struct adc_dt_spec *spec)
{
    struct adc_sequence seq = ADC_DT_SPEC_GET_SEQ(*spec, &s_adc_buf, sizeof(s_adc_buf));
    if (!adc_is_ready_dt(spec) || adc_read_dt(spec, &seq) != 0) {
        return 0;
    }
    return (uint16_t)(s_adc_buf < 0 ? 0 : s_adc_buf);
}

#else

static uint16_t read_adc_channel(uint8_t ch_id)
{
    struct adc_sequence seq = {
        .channels = BIT(ch_id),
        .buffer = &s_adc_buf,
        .buffer_size = sizeof(s_adc_buf),
        .resolution = 12
    };
    if (adc_read(s_adc_dev, &seq) != 0) {
        return 0;
    }
    return (uint16_t)(s_adc_buf < 0 ? 0 : s_adc_buf);
}

#endif

static uint16_t read_mic(void *ctx)
{
    ARG_UNUSED(ctx);
#if DT_NODE_HAS_STATUS(DT_ALIAS(sw0), okay)
    return read_adc_dt(&s_mic_adc);
#else
    return read_adc_channel(1);
#endif
}

static uint16_t read_batt(void *ctx)
{
    ARG_UNUSED(ctx);
#if DT_NODE_HAS_STATUS(DT_ALIAS(sw0), okay)
    return (uint16_t)(read_adc_dt(&s_batt_adc) * 4200 / 4095);
#else
    return (uint16_t)(read_adc_channel(2) * 4200 / 4095);
#endif
}

static bool read_button(void *ctx)
{
    ARG_UNUSED(ctx);
#if DT_NODE_HAS_STATUS(DT_ALIAS(sw0), okay)
    return gpio_pin_get_dt(&s_button) != 0;
#else
    return gpio_pin_get(s_gpio0, PIN_BUTTON) != 0;
#endif
}

static bool is_charging(void *ctx)
{
    ARG_UNUSED(ctx);
#if DT_NODE_HAS_STATUS(DT_ALIAS(sw0), okay)
    return gpio_pin_get_dt(&s_charge) != 0;
#else
    return gpio_pin_get(s_gpio0, PIN_CHARGE) != 0;
#endif
}

static uint32_t millis(void *ctx)
{
    ARG_UNUSED(ctx);
    return (uint32_t)k_uptime_get();
}

static void set_led(bool on, void *ctx)
{
    ARG_UNUSED(ctx);
#if DT_NODE_HAS_STATUS(DT_ALIAS(sw0), okay)
    gpio_pin_set_dt(&s_led, on ? 1 : 0);
#else
    gpio_pin_set(s_gpio0, PIN_LED, on ? 1 : 0);
#endif
}

static const vb_board_ops_t s_ops = {
    .read_mic_adc = read_mic,
    .read_batt_adc = read_batt,
    .read_button = read_button,
    .is_charging = is_charging,
    .millis = millis,
    .set_led = set_led,
    .board_ctx = NULL
};

const vb_board_ops_t *board_nrf52_ops(void)
{
    return &s_ops;
}
```

## src/board_nrf52.h
```c
#ifndef BOARD_NRF52_H
#define BOARD_NRF52_H

#include "vb_app.h"

void board_nrf52_init(void);
const vb_board_ops_t *board_nrf52_ops(void);

#endif
```
